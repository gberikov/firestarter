## main/Kconfig.projbuild
```kconfig
menu "Firestarter Configuration"

config ANT_RF_SWITCH_GPIO
    int "Antenna RF switch power GPIO"
    default 3
    help
        GPIO that powers the FM8625H RF switch on the XIAO ESP32-C6.
        Active-low: the firmware drives it LOW to enable antenna switching.

config ANT_SELECT_GPIO
    int "Antenna select GPIO"
    default 14
    help
        GPIO that selects the antenna on the XIAO ESP32-C6.
        LOW = on-board ceramic antenna, HIGH = external U.FL antenna.

endmenu

menu "Firestarter Wi-Fi Configuration"

config FIRESTARTER_WIFI_SSID
    string "Wi-Fi SSID"
    default "Firestarter"
    help
        The SSID (name) of the Wi-Fi network.

config FIRESTARTER_WIFI_PASSWORD
    string "Wi-Fi Password"
    default ""
    help
        Password for the Wi-Fi AP (8-63 chars for WPA2; leave empty for an
        open network). Set this locally via `idf.py menuconfig` — it is
        stored only in the git-ignored sdkconfig and must NOT be committed.

endmenu
```

## sdkconfig.defaults
```kconfig
# Shared, non-secret project defaults. idf.py applies these on a fresh build
# to (re)generate the local sdkconfig. The active sdkconfig is git-ignored
# because it holds your real Wi-Fi password — never put secrets here.

# Chip / flash
CONFIG_IDF_TARGET="esp32c6"
CONFIG_ESPTOOLPY_FLASHSIZE_2MB=y
CONFIG_ESPTOOLPY_FLASHSIZE="2MB"

# WebSocket support in esp_http_server (required for live launch status push)
CONFIG_HTTPD_WS_SUPPORT=y
```
